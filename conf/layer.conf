## conf/layer.conf
```bitbake
# We have a conf and classes directory, add to BBPATH
BBPATH .= ":${LAYERDIR}"

# We have recipes-* directories, add to BBFILES
BBFILES += "${LAYERDIR}/recipes-*/*/*.bb \
            ${LAYERDIR}/recipes-*/*/*.bbappend"

BBFILE_COLLECTIONS += "technux"
BBFILE_PATTERN_technux = "^${LAYERDIR}/"
BBFILE_PRIORITY_technux = "9"

IMAGE_INSTALL_append = " technux-mod smartux-mod"

PREFERRED_PROVIDER_virtual/kernel = "linux-yocto-technux"
```

## conf/machine/technux-rpi.conf
```bitbake
#@TYPE: Machine
#@NAME: RaspberryPi Development Board
#@DESCRIPTION: Technux machine configuration for the RaspberryPi http://www.raspberrypi.org/ Board
#@MAINTAINER: Technux (http://www.technux.se)

DEFAULTTUNE ?= "arm1176jzfshf"
require conf/machine/include/tune-arm1176jzf-s.inc
include conf/machine/include/rpi-base.inc

PREFERRED_PROVIDER_virtual/kernel = "linux-raspberrypi"
PREFERRED_PROVIDER_u-boot = "u-boot-rpi"

PREFERRED_VERSION_linux-raspberrypi ?= "3.18.%"

IMAGE_FSTYPES ?= "tar.bz2 ext3 rpi-sdimg"
KERNEL_IMAGETYPE ?= "Image"
SERIAL_CONSOLE = "115200 ttyAMA0"

IMAGE_CLASSES += "sdcard_image-rpi"
SDIMG_KERNELIMAGE_technux-rpi ?= "kernel.img"
```
